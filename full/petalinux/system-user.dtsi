/ {
};

/* SD */
&sdhci1 {
	disable-wp;
	no-1-8-v;
};

&gem3 {
    status = "okay";
    local-mac-address = [00 0a 35 00 02 90];
};


/*
&gem3 {
	status = "okay";
	local-mac-address = [00 0a 35 00 02 90];
	phy-mode = "rgmii-id";
	phy-handle = <&phy0>;
	phy0: phy@9 {
		reg = <0x9>;
		ti,rx-internal-delay = <0x5>;
		ti,tx-internal-delay = <0x5>;
		ti,fifo-depth = <0x1>;
	};
};


&sdhci1 {
	status = "okay";
	max-frequency = <50000000>;
    disable-wp;
};
*/

