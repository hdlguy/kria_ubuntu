/ {

    fclk0: fclk0{
        status = "okay";
        compatible = "xlnx,fclk";
        clock-names = "s_axi_aclk";  
        clocks = <&zynqmp_clk 71>;
    };

/*
    clocking0: clocking0 {
        compatible = "xlnx,fclk";
        status = "okay";
        assigned-clocks = <&zynqmp_clk 71>;
        assigned-clock-rates = <99999001>;
        #clock-cells = <0>;
        clock-output-names = "fabric_clk";
        clocks = <&zynqmp_clk 71>;
    };
*/

};

/* SD */
&sdhci1 {
	disable-wp;
	 no-1-8-v;
	/* max-frequency = <50000000>; */
};

&gem3 {
    status = "okay";
    local-mac-address = [00 0a 35 00 02 90];
};


/*
*/

